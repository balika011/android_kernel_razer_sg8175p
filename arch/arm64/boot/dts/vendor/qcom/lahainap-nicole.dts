/dts-v1/;

#include "lahainap-v2.1.dtsi"
#include "lahainap-nicole.dtsi"

/ {
	model = "Qualcomm Technologies, Inc. Nicole";
	compatible = "qcom,lahaina-hdk", "qcom,lahaina", "qcom,hdk";
	qcom,board-id = <0x1001f 0x02>;
};
